## config/boards/shields/mini18/Kconfig.defconfig
```kconfig
# Copyright (c) 2020 The ZMK Contributors
# SPDX-License-Identifier: MIT

if SHIELD_MINI18_LEFT

config ZMK_KEYBOARD_NAME
    default "Nocc Mini 16 (Flat)"

config ZMK_SPLIT_ROLE_CENTRAL
    default y

endif

if SHIELD_MINI18_LEFT || SHIELD_MINI18_RIGHT

config ZMK_SPLIT
    default y

endif
```

## config/boards/shields/mini18/Kconfig.shield
```kconfig
# Copyright (c) 2020 The ZMK Contributors
# SPDX-License-Identifier: MIT

config SHIELD_MINI18_LEFT
	def_bool $(shields_list_contains,mini18_left)

config SHIELD_MINI18_RIGHT
	def_bool $(shields_list_contains,mini18_right)
```
